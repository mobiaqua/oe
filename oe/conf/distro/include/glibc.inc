## oe/conf/distro/include/glibc.inc
```bitbake
PREFERRED_PROVIDER_virtual/libiconv ?= "glibc"
PREFERRED_PROVIDER_virtual/libintl ?= "glibc"
PREFERRED_PROVIDER_virtual/libc = "glibc"
PREFERRED_PROVIDER_virtual/${TARGET_PREFIX}libc-initial = "glibc-initial"
PREFERRED_PROVIDER_virtual/${TARGET_PREFIX}libc-for-gcc = "glibc"

# glibc is configured for OLDEST_KERNEL kernel version, so we set minimal
# sane versions there

OLDEST_KERNEL ?= "2.4.0"

# ARM OABI is fine with 2.4.0, EABI is not, so we override on "-gnueabi"
# TARGET_OS here, not on architecture which is 'arm' in both cases
OLDEST_KERNEL_linux-gnueabi ?= "2.6.16"
OLDEST_KERNEL_sparc64 ?= "2.4.21"
OLDEST_KERNEL_ppc64 ?= "2.4.21"
DISTRO_FEATURES_GLIBC ?= "ipv6 backtrace big-macros bsd cxx-tests catgets \
                           charsets crypt crypt-ufc db-aliases envz fcvt fmtmsg \
                           fstab ftraverse getlogin idn inet inet-anl libm \
                           libm-big locales locale-code memusage nis nsswitch \
                           rcmd rtld-debug spawn streams sunrpc utmp utmpx \
                           wordexp posix-clang-wchar posix-regexp \
                           posix-regexp-glibc posix-wchar-io"
```

## oe/conf/distro/mobiaqua-car.conf
```bitbake
#@TYPE: Distribution
#@NAME: mobiaqua
#@DESCRIPTION: Distribution configuration for MobiAqua Car

THUMB_INTERWORK = "yes"

require conf/distro/mobiaqua.conf

DISTRO = "mobiaqua-car"
DISTRO_NAME = "MobiAqua Car"
```

## oe/conf/distro/mobiaqua-pda-pxa250.conf
```bitbake
#@TYPE: Distribution
#@NAME: mobiaqua-pda-pxa250
#@DESCRIPTION: Distribution configuration for PDA with CPU PXA250

require conf/distro/mobiaqua.conf

DISTRO = "mobiaqua-pda-pxa250"
DISTRO_NAME = "MobiAqua PDA PXA250"
```

## oe/conf/distro/mobiaqua-pda-sa1110.conf
```bitbake
#@TYPE: Distribution
#@NAME: mobiaqua-pda-sa1110
#@DESCRIPTION: Distribution configuration for PDA SA1110

require conf/distro/mobiaqua.conf

DISTRO = "mobiaqua-pda-sa1110"
DISTRO_NAME = "MobiAqua PDA SA1110"
```

## oe/conf/distro/mobiaqua-tv.conf
```bitbake
#@TYPE: Distribution
#@NAME: mobiaqua-tv
#@DESCRIPTION: Distribution configuration for MobiAqua TV

THUMB_INTERWORK = "yes"

require conf/distro/mobiaqua.conf

DISTRO = "mobiaqua-tv"
DISTRO_NAME = "MobiAqua TV"
```

## oe/conf/distro/mobiaqua.conf
```bitbake
#@TYPE: Distribution
#@NAME: mobiaqua
#@DESCRIPTION: Distribution configuration for MobiAqua
MAINTAINER = "aquadran"

DISTRO_FEATURES += "kernel26 ipv4 largefile nls sysvinit"

INHERIT += "insane recipe_sanity sanity debian devshell package_ipk packaged-staging"

DISTRO = "mobiaqua"
DISTRO_NAME = "MobiAqua"

PREFERRED_PROVIDER_opkg = "opkg"
PREFERRED_PROVIDER_hotplug = "udev"

DISTRO_XORG_CONFIG_MANAGER = "udev"

PREFERRED_PROVIDER_virtual/update-alternatives = "opkg"
PREFERRED_PROVIDER_virtual/update-alternatives-native = "opkg-native"

IPKG_VARIANT = "opkg"

DISTRO_BLUETOOTH_MANAGER = "bluez4"
PREFERRED_PROVIDER_bluez-utils-dbus = "bluez4"
PREFERRED_PROVIDER_bluez-libs = "bluez4"
PREFERRED_PROVIDER_bluez-utils = "bluez4"

SOC_FAMILY ?= "Unknown"

MACHINE_CLASS ?= ""
MACHINE_OVERRIDES += "${MACHINE_CLASS}"
MACHINE_OVERRIDES += "${SOC_FAMILY}"

ENABLE_BINARY_LOCALE_GENERATION = "0"

LIBC = "glibc"
require conf/distro/include/toolchain-internal.inc
require conf/distro/include/arm-thumb.inc
require conf/distro/include/${LIBC}-internal.inc

LIMIT_BUILT_LOCALES ?= "en_GB"

USE_NLS = "yes"

USE_VT = "0"
SYSVINIT_ENABLED_GETTYS = "1"

# Root home directory
ROOT_HOME ??= "/home/root"
```

## oe/conf/machine/board-tv.conf
```bitbake
#@TYPE: Machine
#@NAME: OMAP4430 PandaBoard, OMAP4460 Pandaboard ES, OMAP5432 IGEPv5, AM5728 BeagleBoard X15
#@DESCRIPTION: Machine configuration for the PandaBoard, Pandaboard ES, IGEPv5, BeagleBoard X15

require conf/machine/include/soc-tv.inc

TARGET_FPU_arm = "hard"
ARM_FP_ABI = "hardfp"
ARM_INSTRUCTION_SET = "thumb"

PREFERRED_PROVIDER_virtual/bootloader = "u-boot-pandaboard"
PREFERRED_PROVIDER_virtual/kernel = "linux-omap419"

GUI_MACHINE_CLASS = "bigscreen"

SERIAL_CONSOLE = "115200 ttyS2"

OVERRIDES .= ":${FEED_ARCH}"

IMAGE_FSTYPES = "tar.gz"
```

## oe/conf/machine/igep0030.conf
```bitbake
#@TYPE: Machine
#@NAME: IGEP machine
#@DESCRIPTION: Machine configuration for the IGEPv3.0 board
TARGET_ARCH = "arm"

TARGET_FPU_arm = "hard"
ARM_FP_ABI = "softfp"

GUI_MACHINE_CLASS = "bigscreen"

include conf/machine/include/tune-cortexa8.inc

SERIAL_CONSOLE = "115200 ttyO2"

PREFERRED_PROVIDER_virtual/kernel = "linux-omap3"
PREFERRED_PROVIDER_virtual/bootloader = "u-boot-igepv3"

OVERRIDES .= ":${FEED_ARCH}"

IMAGE_FSTYPES = "tar.gz"
```

## oe/conf/machine/include/omap3.inc
```bitbake
SOC_FAMILY = "omap3"
TARGET_ARCH = "arm"

require conf/machine/include/tune-cortexa8.inc
PREFERRED_PROVIDER_virtual/kernel = "linux-omap3"

KERNEL_IMAGETYPE = "uImage"

UBOOT_ENTRYPOINT = "0x80008000"
UBOOT_LOADADDRESS = "0x80008000"

EXTRA_IMAGEDEPENDS += "u-boot x-loader"
```

## oe/conf/machine/qemux86.conf
```bitbake
#@TYPE: Machine
#@NAME: qemu x86 Emulator setup
#@DESCRIPTION: Machine configuration for running an x86 system under qemu emulation

require conf/machine/include/tune-pentiumpro.inc

KERNEL_IMAGETYPE = "bzImage"

SERIAL_CONSOLE = "115200 ttyS0"

PREFERRED_PROVIDER_virtual/kernel = "linux-qemu"

GLIBC_ADDONS = "nptl"
GLIBC_EXTRA_OECONF = "--with-tls"

IMAGE_FSTYPES = "tar.gz"

MACHINE_FEATURES = "kernel26"
MACHINE_KERNEL_VERSION = "2.6"

# Don't include kernels in standard images
RDEPENDS_kernel-base = ""

EXTRA_IMAGEDEPENDS += "qemu-native"
```
